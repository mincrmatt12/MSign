## esp/components/bearssl_supplicant/Kconfig
```kconfig
menu "TLS Buffer Manager"
	
	config WPA_BR_TLS_OUT_SIZE
		int "TX Buffer size"
		default 1024

endmenu
```

## esp/main/Kconfig.projbuild
```kconfig
menu "MSign"

config SDCARD_CS_IO
	int "SDCS GPIO number"
	default 5

config SDCARD_CLK_IO
	int "SDCLK GPIO number"
	default 14

config SDCARD_MISO_IO
	int "SD_MISO GPIO number"
	default 12

config SDCARD_MOSI_IO
	int "SD_MOSI GPIO number"
	default 4

config DISABLE_CFGPULL
	bool "Force disabling of auto-system update"
	default n

config ENABLE_CRASHLOGS
	bool "Enable SD-card crash logs"
	select ESP_PANIC_USER_REBOOT
	default y

endmenu
```
